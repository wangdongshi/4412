## u-boot/u-boot-x4412/board/samsung/x4412/Kconfig
```kconfig
if TARGET_X4412

config SYS_BOARD
	default "x4412"

config SYS_VENDOR
	default "samsung"

config SYS_CONFIG_NAME
	default "x4412"

endif
```

## u-boot/u-boot-x4412/configs/x4412_defconfig
```kconfig
CONFIG_ARM=y
CONFIG_ARCH_EXYNOS=y
CONFIG_TARGET_X4412=y
CONFIG_DEFAULT_DEVICE_TREE="exynos4412-x4412"
CONFIG_SPL=y
CONFIG_SYS_PROMPT="X4412 # "
CONFIG_OF_EMBED=y
# CONFIG_CMD_IMLS is not set
# CONFIG_CMD_XIMG is not set
# CONFIG_CMD_FPGA is not set
# CONFIG_CMD_NET is not set
# CONFIG_CMD_NFS is not set
# CONFIG_CMD_MISC is not set
CONFIG_OF_CONTROL=y
CONFIG_USB=y
CONFIG_DM_USB=y
```
